## boards/labfermion/carnlog/board.yml
```yaml
board:
  name: carnlog
  full_name: carnlog
  vendor: labfermion
  socs:
    - name: nrf52840
```

## boards/labfermion/carnlog/carnlog_defconfig
```kconfig
# CONFIG_ARM_MPU=y

CONFIG_I2C=y
CONFIG_SENSOR=y
CONFIG_GPIO=y

CONFIG_LSM6DSO=y
CONFIG_LSM6DSO_TRIGGER_GLOBAL_THREAD=y

CONFIG_USB_DEVICE_STACK=y
# CONFIG_USB_DEVICE_STACK_NEXT=y

CONFIG_USB_DEVICE_VID=0x2FE3
CONFIG_USB_DEVICE_PID=0x1234
# CONFIG_USB_DEVICE_PID=0x0110

CONFIG_USB_DEVICE_MANUFACTURER="Lab Fermion"
CONFIG_USB_DEVICE_PRODUCT="Carnlog"
CONFIG_USB_DEVICE_SN="0123456789ABCDEF"

CONFIG_USB_SELF_POWERED=n
CONFIG_USB_MAX_POWER=123

CONFIG_USB_DEVICE_INITIALIZE_AT_BOOT=y
CONFIG_UART_INTERRUPT_DRIVEN=y 
# CONFIG_USB_COMPOSITE_DEVICE=y
# CONFIG_USB_DEVICE_BOS=y
# CONFIG_USB_DEVICE_OS_DESC=y


CONFIG_SERIAL=y
CONFIG_CONSOLE=y
CONFIG_UART_CONSOLE=y
CONFIG_UART_LINE_CTRL=y

CONFIG_USB_CDC_ACM=y
CONFIG_STDOUT_CONSOLE=y
CONFIG_CBPRINTF_FP_SUPPORT=y
# CONFIG_CDC_ACM_SERIAL_INITIALIZE_AT_BOOT=y
```
